/*
 * Copyright (C) 2015 Freescale Semiconductor, Inc.
 *
 * Copyright (C) 2015-2016 Variscite Ltd. - http://www.variscite.com
 *
 * This program is free software; you can redistribute it and/or modify
 * it under the terms of the GNU General Public License version 2 as
 * published by the Free Software Foundation.
 */
/* #define WIFI */
/* #define EMMC */
/* #define  NAND  */
/dts-v1/;

#include <dt-bindings/input/input.h>
#include "imx6ull.dtsi"
#include "imx6ul-imx6ull-var-dart-common.dtsi"

/ {
#ifdef NAND
#ifdef WIFI
	model = "Variscite i.MX6 ULL DART NAND/WIFI";
#else
	model = "Variscite i.MX6 ULL DART NAND/SD";
#endif
#endif
#ifdef EMMC
#ifdef WIFI
	model = "Variscite i.MX6 ULL DART EMMC/WIFI";
#else
	model = "Variscite i.MX6 ULL DART EMMC/SD";
#endif
#endif
	compatible = "fsl,imx6ull-var-dart", "fsl,imx6ull";
};
